## sdkconfig.defaults
```kconfig
# Основные настройки для ESP-IDF v6.0
CONFIG_ESP_MAIN_TASK_STACK_SIZE=32768
CONFIG_ESP_DEFAULT_CPU_FREQ_MHZ=160

CONFIG_ESP_TASK_WDT=y
CONFIG_ESP_TASK_WDT_TIMEOUT_S=30
CONFIG_ESP_REV_MIN=0

# SPIFFS для веб-файлов
CONFIG_SPIFFS_MAX_FILES=50
CONFIG_SPIFFS_USE_MTIME=y
CONFIG_SPIFFS_PAGE_CHECK=y

# WiFi
CONFIG_ESP_WIFI_STA_DISCONNECT_PM_ENABLE=y
CONFIG_ESP_WIFI_AMPDU_TX_ENABLED=y
CONFIG_ESP_WIFI_TX_BA_WIN=6
CONFIG_ESP_WIFI_RX_BA_WIN=6
CONFIG_ESP_WIFI_DYNAMIC_TX_BUFFER_NUM=32

# Ethernet (для ESP32-C6)
CONFIG_ETH_USE_ESP32_EMAC=y
CONFIG_ETH_PHY_INTERFACE_RMII=y
CONFIG_ETH_PHY_MODEL_LAN8720=y

# Bluetooth (опционально)
CONFIG_BT_ENABLED=y
CONFIG_BT_BLE_ENABLED=y
CONFIG_BT_NIMBLE_ENABLED=y
CONFIG_BT_NIMBLE_ROLE_PERIPHERAL=y
CONFIG_BT_NIMBLE_MAX_CONNECTIONS=4

# USB (для ESP32-C6)
CONFIG_USB_ENABLED=y
CONFIG_USB_OTG_SUPPORTED=y
CONFIG_USB_CDC_SUPPORTED=y
CONFIG_USB_HID_SUPPORTED=y

# SPI и I2C
CONFIG_SPI_MASTER_IN_IRAM=y
CONFIG_SPI_MASTER_ISR_IN_IRAM=y
CONFIG_I2C_MASTER_SUPPORT=y
CONFIG_I2C_QUEUE_SIZE=100

# I2S (аудио)
CONFIG_I2S_SUPPORTED=y
CONFIG_I2S_ISR_IRAM_SAFE=y
CONFIG_I2S_DMA_BUFFER_COUNT=8
CONFIG_I2S_DMA_BUFFER_SIZE=1024

# ADC
CONFIG_ADC_CONTINUOUS_MODE=y
CONFIG_ADC_DISABLE_DAC=y
CONFIG_ADC_CALI_EFUSE_TP_ENABLE=y

# Modbus (v6.0)
CONFIG_MB_COMM_MODE_RTU_EN=y
CONFIG_MB_COMM_MODE_TCP_EN=y
CONFIG_MB_TIMER_PORT_ENABLED=y
CONFIG_MB_MASTER_TIMEOUT_MS_MS=150
CONFIG_MB_MASTER_QUEUE_SIZE=20
CONFIG_MB_SLAVE_QUEUE_SIZE=20
CONFIG_MB_PORT_TASK_STACK_SIZE=4096

# HTTP сервер
CONFIG_HTTPD_MAX_REQ_HDR_LEN=1024
CONFIG_HTTPD_MAX_URI_LEN=512
CONFIG_HTTPD_WS_SUPPORT=y

# SNTP (время)
CONFIG_LWIP_SNTP=y
CONFIG_SNTP_TIME_SERVERS="pool.ntp.org;time.google.com;ru.pool.ntp.org"

# mDNS
CONFIG_MDNS_ENABLE=y
CONFIG_MDNS_MAX_SERVICES=10
CONFIG_MDNS_TASK_PRIORITY=1

# Логи
CONFIG_LOG_DEFAULT_LEVEL_INFO=y
CONFIG_LOG_MAXIMUM_LEVEL_DEBUG=y
CONFIG_LOG_COLORS=y
```
